## sdkconfig.defaults
```kconfig
# Enable C++ exceptions and set emergency pool size for exception objects
CONFIG_COMPILER_CXX_EXCEPTIONS=y
CONFIG_COMPILER_CXX_EXCEPTIONS_EMG_POOL_SIZE=1024

CONFIG_FREERTOS_SUPPORT_STATIC_ALLOCATION=n

CONFIG_PARTITION_TABLE_CUSTOM=y
CONFIG_PARTITION_TABLE_CUSTOM_FILENAME="partitions.csv"
CONFIG_PARTITION_TABLE_FILENAME="partitions.csv"

CONFIG_ESPTOOLPY_FLASHSIZE_4MB=y
CONFIG_ESPTOOLPY_FLASHSIZE="4MB"	

CONFIG_PTHREAD_TASK_STACK_SIZE_DEFAULT=3584
CONFIG_ESP32_PTHREAD_TASK_STACK_SIZE_DEFAULT=3584
CONFIG_ESP_MAIN_TASK_STACK_SIZE=6144

# Maximum length of file path
CONFIG_SPIFFS_OBJ_NAME_LEN=64

# LilyGo Oled have crystal @ 26 MHz
CONFIG_ESP32_XTAL_FREQ_26=y
CONFIG_ESP32_XTAL_FREQ=26

# Enable PPP in LWIP
CONFIG_LWIP_PPP_SUPPORT=y
CONFIG_LWIP_PPP_NOTIFY_PHASE_SUPPORT=y
CONFIG_LWIP_PPP_PAP_SUPPORT=y
CONFIG_LWIP_PPP_CHAP_SUPPORT=y
CONFIG_LWIP_PPP_MSCHAP_SUPPORT=y
CONFIG_LWIP_PPP_MPPE_SUPPORT=y

# Modem config

# This is inactive in our project
CONFIG_EXAMPLE_MODEM_DEVICE_BG96=y

# TODO below block must be possible to configure at runtime
CONFIG_EXAMPLE_MODEM_APN="CMNET"
CONFIG_EXAMPLE_MODEM_PPP_AUTH_USERNAME="espressif"
CONFIG_EXAMPLE_MODEM_PPP_AUTH_PASSWORD="esp32"

CONFIG_EXAMPLE_UART_MODEM_TX_PIN=27
CONFIG_EXAMPLE_UART_MODEM_RX_PIN=26
CONFIG_EXAMPLE_UART_MODEM_RTS_PIN=25
CONFIG_EXAMPLE_UART_MODEM_CTS_PIN=23

CONFIG_EXAMPLE_UART_EVENT_TASK_STACK_SIZE=2048
CONFIG_EXAMPLE_UART_EVENT_TASK_PRIORITY=5
CONFIG_EXAMPLE_UART_EVENT_QUEUE_SIZE=30
CONFIG_EXAMPLE_UART_PATTERN_QUEUE_SIZE=20
CONFIG_EXAMPLE_UART_TX_BUFFER_SIZE=512
CONFIG_EXAMPLE_UART_RX_BUFFER_SIZE=1024
```
